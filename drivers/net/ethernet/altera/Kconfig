## drivers/net/ethernet/altera/Kconfig
```kconfig
#
# Altera Network Device Configuration
# 

config NET_VENDOR_ALTERA
	bool "Altera network devices"
	default y
	---help---
	Altera FPGA SoC network drivers.

if NET_VENDOR_ALTERA

config ALTERA_TSE
	tristate "Altera Triple-Speed Ethernet MAC support"
	depends on HAS_DMA
	select PHYLIB
	---help---
	  This driver supports the Altera Triple-Speed (TSE) Ethernet MAC.

	  To compile this driver as a module, choose M here. The module
	  will be called alteratse.

endif # NET_VENDOR_ALTERA
```

## drivers/net/ethernet/crossfield/Kconfig
```kconfig
#
# Altera Network Device Configuration
# 

config NET_VENDOR_CROSSFIELD
	bool "Crossfield network device drivers"
	default y
	---help---
	Crossfield network drivers for Intel FPGA SoCs.

if NET_VENDOR_CROSSFIELD

config CROSSFIELD_EHIP
	tristate "Crossfield Ethernet Hard IP support for Intel FPGA SoCs"
	depends on HAS_DMA
	select PHYLINK
	---help---
	  This driver supports the Intel Stratix 10 100G Hard IP MAC+PCS
	  with Crossfield's DMA engine.

	  To compile this driver as a module, choose M here. The module
	  will be called crossfieldehip.

endif # NET_VENDOR_CROSSFIELD
```
